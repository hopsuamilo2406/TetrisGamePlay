#include <stdio.h>
#include <math.h>
#include "NuMicro.h"
#include "EBI_LCD_Module.h"
#define IMAGE_WIDTH  60
#define IMAGE_HEIGHT 80


const uint16_t sample_image[60 * 80] = {
  0x84e4, 0x8503, 0x8543, 0x4aa0, 0x01a0, 0x0220, 0x3401, 0x44e2, 0x44a3, 0x3c22, 0x42a1, 0x8ca7,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 0x5301, 
  0x7462, 0x53e0, 0x5c20, 0x4a60, 0x09e0, 0x2380, 0x3ca2, 0x4ce2, 0x4cc3, 0x3c22, 0x4ac1, 0x8ca7,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 0x4a61, 
  0x74a2, 0x3b00, 0x32c0, 0x5280, 0x3340, 0x3ca1, 0x44c2, 0x5503, 0x4ce3, 0x3c42, 0x6321, 0x8467,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 0x5282, 
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  0x1200, 0x1220, 0x2360, 0x2380, 0x2380, 0x4441, 0x2bc0, 0x11c0, 0x0980, 0x09a0, 0x09c0, 0x1a60,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 0x5442
};
//rew
void new_SystemInit(void)
{
     // 1. Enable HXT (External 12MHz Crystal)
    CLK->PWRCTL |= (1 << 0); // HXTEN_Msk
    // 2. Wait for HXT ready
    while (!(CLK->STATUS & (1 << 0))); // HXTSTB_Msk
    // 3. Set HCLK source to HXT (00: HXT)
    CLK->CLKSEL0 = (CLK->CLKSEL0 & ~(0x7 << 0)) | (0x0 << 0); // HCLKSEL = 0: HXT
    // 4. Set HCLK divider to 1
    CLK->CLKDIV0 = (CLK->CLKDIV0 & ~(0xF << 0)) | (0x0 << 0); // HCLKDIV = 0: /1
    SystemCoreClockUpdate();
}
//rew
void UART0_Init(void)
{
    // 1. Enable UART0 clock
    CLK->APBCLK0 |= (1 << 16); // UART0CKEN_Msk
    // 2. Select HXT as UART0 clock source (UART0SEL = 0)
    CLK->CLKSEL1 = (CLK->CLKSEL1 & ~(0x7 << 24)) | (0x0 << 24);
    // 3. Set UART0 clock divider to 1 (UART0DIV = 0)
    CLK->CLKDIV0 = (CLK->CLKDIV0 & ~(0xF << 8)) | (0x0 << 8);
    // 4. Set Multi-Function for PB.12 (RXD) and PB.13 (TXD)
    SYS->GPB_MFPH = (SYS->GPB_MFPH & ~((0xF << 16) | (0xF << 20))) | (0x7 << 16) | (0x7 << 20);
    // 5. UART0: 115200 baud, 8-N-1
    // Baudrate = UART_CLK / (16 * (BRD+2)), BRD = (UART_CLK/baud/16)-2
    // UART_CLK = 12MHz, baud = 115200
    // BRD = (12000000/115200/16)-2 = 63.1-2 ~ 61
    UART0->BAUD = (0x3 << 28) | (61); // MODE2, DIVIDER = 61
    UART0->LINE = 0x3; // 8 data bits, no parity, 1 stop bit
}
//rew
void Timer1_Init(void)
{
       // 1. Enable Timer1 clock
    CLK->APBCLK0 |= (1 << 3); // TMR1CKEN
    // 2. Select HXT as Timer1 clock source (TMR1SEL = 0)
    CLK->CLKSEL1 = (CLK->CLKSEL1 & ~(0x7 << 8)) | (0x0 << 8);
    // 3. Set Timer1 to periodic mode, prescale = 0, compare = 1200000 (0.1s @12MHz)
    TIMER1->CTL = 0; // Stop timer
    TIMER1->CMP = 1200000;
    TIMER1->CTL = (1 << 29) | (1 << 2); // INTEN, periodic mode
    // 4. Enable Timer1 interrupt in NVIC
    NVIC->ISER[0] = (1 << (33 % 32)); // TMR1_IRQn = 33
    // 5. Start Timer1
    TIMER1->CTL |= (1 << 30); // CNTEN
}
void EADC_Init(void)
{
    // 1. Enable EADC clock
    CLK->APBCLK0 |= (1 << 28); // EADCCKEN
    // 2. Set EADC clock source (HXT, 12MHz)
    CLK->CLKSEL0 = (CLK->CLKSEL0 & ~(0x7 << 28)) | (0x0 << 28); // EADCSEL = 0: HXT
    // 3. Set EADC clock divider (EADCDIV = 0: /1)
    CLK->CLKDIV0 = (CLK->CLKDIV0 & ~(0xFF << 16)) | (0x0 << 16);
    // 4. Enable EADC module
    EADC->CTL |= (1 << 0); // ADCEN
    // 5. Wait for EADC ready
    while (!(EADC->STATUS2 & (1 << 16))); // ADCRDYF
}

//rew
void EBI_LCD_Init(void)
{
    CLK_EnableModuleClock(EBI_MODULE);

     SYS->GPG_MFPH &= ~((0xF << 4)  | (0xF << 8)  | (0xF << 12) |
                       (0xF << 16) | (0xF << 20) | (0xF << 24));
    SYS->GPG_MFPH |=  ((0x2 << 4)  | (0x2 << 8)  | (0x2 << 12) |
                       (0x2 << 16) | (0x2 << 20) | (0x2 << 24));

    SYS->GPD_MFPH &= ~((0xF << 0) | (0xF << 4));
    SYS->GPD_MFPH |=  ((0x2 << 0) | (0x2 << 4));
    // PE.14 (bit 24~27), PE.15 (bit 28~31) -> EBI_AD8, EBI_AD9 (0x2)
    SYS->GPE_MFPH &= ~((0xF << 24) | (0xF << 28));
    SYS->GPE_MFPH |=  ((0x2 << 24) | (0x2 << 28));
    // PE.1 (bit 4~7), PE.0 (bit 0~3) -> EBI_AD10, EBI_AD11 (0x2)
    SYS->GPE_MFPL &= ~((0xF << 4) | (0xF << 0));
    SYS->GPE_MFPL |=  ((0x2 << 4) | (0x2 << 0));
    // PH.8 (bit 0~3), PH.9 (bit 4~7), PH.10 (bit 8~11), PH.11 (bit 12~15) -> EBI_AD12~15 (0x2)
    SYS->GPH_MFPH &= ~((0xF << 0) | (0xF << 4) | (0xF << 8) | (0xF << 12));
    SYS->GPH_MFPH |=  ((0x2 << 0) | (0x2 << 4) | (0x2 << 8) | (0x2 << 12));
    // PE.4 (bit 16~19), PE.5 (bit 20~23) -> EBI_nWR, EBI_nRD (0x2)
    SYS->GPE_MFPL &= ~((0xF << 16) | (0xF << 20));
    SYS->GPE_MFPL |=  ((0x2 << 16) | (0x2 << 20));
    // PD.14 (bit 24~27) -> EBI_nCS0 (0x2)
    SYS->GPD_MFPH &= ~(0xF << 24);
    SYS->GPD_MFPH |=  (0x2 << 24);

    GPIO_SetMode(PH, BIT3, GPIO_MODE_OUTPUT);
    PH3 = 1; // LCD_RS

    GPIO_SetMode(PB, BIT6 | BIT7, GPIO_MODE_OUTPUT);
    PB6 = 1; // LCD_RST
    PB7 = 1; // Backlight
		
		
    //EBI_Open(EBI_BANK0, EBI_BUSWIDTH_16BIT, EBI_TIMING_NORMAL, 0, EBI_CS_ACTIVE_LOW);
		EBI->CTL0 = (1 << 0)    // EN: EBI Enable
           | (1 << 1)   // DW16: 16-bit mode
           | (1 << 8);  // MCLKDIV = 01 ()
    EBI->TCTL0 |= (EBI_TCTL0_WAHDOFF_Msk | EBI_TCTL0_RAHDOFF_Msk);
}

void LCD_Draw_Rectangular(uint16_t x, uint16_t y, uint16_t w, uint16_t h, uint16_t color)
{
	uint16x2_t i;
    for (i= 0; i < 2; i++) {
        LCD_BlankArea(x, y + i, w, 1, color);         // Top border (2 px thick)
        LCD_BlankArea(x, y + h - 1 - i, w, 1, color); // Bottom border
        LCD_BlankArea(x + i, y, 1, h, color);         // Left border
        LCD_BlankArea(x + w - 1 - i, y, 1, h, color); // Right border
    }
}
void LCD_Draw_Circle(int x0, int y0, int r, uint16_t color)
{
    int x = r;
    int y = 0;
    int err = 1 - r;

    while (x >= y)
    {
        // Draw 8 symmetrical points
        LCD_SetWindow(x0 + x, x0 + x, y0 + y, y0 + y); LCD_WR_DATA(color);
        LCD_SetWindow(x0 + y, x0 + y, y0 + x, y0 + x); LCD_WR_DATA(color);
        LCD_SetWindow(x0 - y, x0 - y, y0 + x, y0 + x); LCD_WR_DATA(color);
        LCD_SetWindow(x0 - x, x0 - x, y0 + y, y0 + y); LCD_WR_DATA(color);
        LCD_SetWindow(x0 - x, x0 - x, y0 - y, y0 - y); LCD_WR_DATA(color);
        LCD_SetWindow(x0 - y, x0 - y, y0 - x, y0 - x); LCD_WR_DATA(color);
        LCD_SetWindow(x0 + y, x0 + y, y0 - x, y0 - x); LCD_WR_DATA(color);
        LCD_SetWindow(x0 + x, x0 + x, y0 - y, y0 - y); LCD_WR_DATA(color);

        y++;
        if (err <= 0)
        {
            err += 2 * y + 1;
        }
        else
        {
            x--;
            err += 2 * (y - x) + 1;
        }
    }
}

void LCD_Draw_Line(uint16_t x0, uint16_t y0, uint16_t x1, uint16_t y1, uint16_t color)
{
    int dx = abs(x1 - x0);
    int sx = x0 < x1 ? 1 : -1;
    int dy = -abs(y1 - y0);
    int sy = y0 < y1 ? 1 : -1;
    int err = dx + dy;
    int e2;

    while (1) {
        LCD_SetWindow(x0, x0, y0, y0);
        LCD_WR_DATA(color);

        if (x0 == x1 && y0 == y1) break;

        e2 = 2 * err;
        if (e2 >= dy) {
            err += dy;
            x0 += sx;
        }
        if (e2 <= dx) {
            err += dx;
            y0 += sy;
        }
    }
}


void LCD_Draw_Star(uint16_t cx, uint16_t cy, uint16_t r, uint16_t color)
{
    float angle;
    int16_t x[5], y[5]; 

    for (int i = 0; i < 5; i++) {
        angle = 2 * 3.14159f * i / 5 - 3.14159f / 2;
        x[i] = cx + (int16_t)(r * cosf(angle));
        y[i] = cy + (int16_t)(r * sinf(angle));
    }

    for (int f = 0; f < 5; f++) {
        int j = (f + 2) % 5; 
        LCD_Draw_Line((uint16_t)x[f], (uint16_t)y[f], (uint16_t)x[j], (uint16_t)y[j], color);
    }
}


void main_LCD_Test(void)
{
    LCD_BlankArea(0, 0, LCD_W, LCD_H, C_BLACK);
    LCD_Picture(60, 80, sample_image, 60, 80); // Centered display
}

void TMR1_IRQHandler(void)
{
    TIMER_ClearIntFlag(TIMER1);
}


int main(void)
{
    SYS_UnlockReg();
    new_SystemInit();
    UART0_Init();
    Timer1_Init();
    EBI_LCD_Init();

    ILI9341_Initial();

    LCD_BlankArea(0, 0, LCD_W, LCD_H, C_BLACK);
    LCD_Draw_Rectangular(10, 10, 60, 40, C_BLUE);
		LCD_Draw_Circle(60, 100, 30, C_RED);
		LCD_Draw_Star(120, 250, 25, C_WHITE);

		//extern const uint16_t sample_image[60 * 80];
		LCD_Picture(160, 80, sample_image, 60, 80);  // Full screen display

    printf("LCD test complete\n");

    while (1);
}